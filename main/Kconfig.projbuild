## main/Kconfig.projbuild
```kconfig
menu "m5apple2"

choice M5APPLE2_CARDPUTER_VARIANT
    prompt "Cardputer variant"
    default M5APPLE2_CARDPUTER_VARIANT_ORIGINAL
    help
        Select the Cardputer hardware profile to build for.

config M5APPLE2_CARDPUTER_VARIANT_ORIGINAL
    bool "Original Cardputer"

config M5APPLE2_CARDPUTER_VARIANT_ADV
    bool "Cardputer ADV"

endchoice

config M5APPLE2_LCD_HOST_ID
    int "LCD SPI host"
    default 3 if M5APPLE2_CARDPUTER_VARIANT_ORIGINAL
    default 2

config M5APPLE2_LCD_WIDTH
    int "LCD width"
    default 240

config M5APPLE2_LCD_HEIGHT
    int "LCD height"
    default 135

config M5APPLE2_LCD_PIN_MOSI
    int "LCD MOSI pin"
    default 35

config M5APPLE2_LCD_PIN_CLK
    int "LCD clock pin"
    default 36

config M5APPLE2_LCD_PIN_CS
    int "LCD CS pin"
    default 37 if M5APPLE2_CARDPUTER_VARIANT_ORIGINAL
    default 33

config M5APPLE2_LCD_PIN_DC
    int "LCD D/C pin"
    default 34

config M5APPLE2_LCD_PIN_RST
    int "LCD reset pin"
    default 33 if M5APPLE2_CARDPUTER_VARIANT_ORIGINAL
    default 37

config M5APPLE2_LCD_PIN_BKLT
    int "LCD backlight pin"
    default 38

config M5APPLE2_LCD_OFFSET_X
    int "LCD X offset"
    default 40 if M5APPLE2_CARDPUTER_VARIANT_ORIGINAL
    default 40

config M5APPLE2_LCD_OFFSET_Y
    int "LCD Y offset"
    default 53 if M5APPLE2_CARDPUTER_VARIANT_ORIGINAL
    default 53

config M5APPLE2_LCD_SWAP_XY
    bool "Swap LCD axes"
    default y

config M5APPLE2_LCD_MIRROR_X
    bool "Mirror LCD X"
    default y if M5APPLE2_CARDPUTER_VARIANT_ORIGINAL
    default n

config M5APPLE2_LCD_MIRROR_Y
    bool "Mirror LCD Y"
    default n if M5APPLE2_CARDPUTER_VARIANT_ORIGINAL
    default y

config M5APPLE2_LCD_PRESERVE_ASPECT
    bool "Preserve Apple II aspect ratio"
    default n if M5APPLE2_CARDPUTER_VARIANT_ORIGINAL
    default y

config M5APPLE2_LCD_MARGIN_LEFT
    int "LCD left safe margin"
    range 0 40
    default 4 if M5APPLE2_CARDPUTER_VARIANT_ORIGINAL
    default 0

config M5APPLE2_LCD_MARGIN_RIGHT
    int "LCD right safe margin"
    range 0 40
    default 0

config M5APPLE2_LCD_MARGIN_TOP
    int "LCD top safe margin"
    range 0 40
    default 0

config M5APPLE2_LCD_MARGIN_BOTTOM
    int "LCD bottom safe margin"
    range 0 40
    default 4 if M5APPLE2_CARDPUTER_VARIANT_ORIGINAL
    default 0

config M5APPLE2_INPUT_USE_UART
    bool "Enable USB/UART console input fallback"
    default y

config M5APPLE2_CPU_HZ
    int "Apple II master CPU clock"
    default 1020484

config M5APPLE2_PERF_LOG_INTERVAL_MS
    int "Performance log interval (ms)"
    default 2000

config M5APPLE2_DETAILED_PERF_PROFILE
    bool "Enable detailed hot-path performance profiling"
    default n
    help
        Enable extra per-slice timing and Disk II progress counters for
        profiling. This adds noticeable overhead in accelerated modes and is
        intended for debugging rather than normal use.

config M5APPLE2_SD_ENABLE
    bool "Enable SD disk library"
    default y

config M5APPLE2_SD_HOST_ID
    int "SD SPI host"
    depends on M5APPLE2_SD_ENABLE
    default 3 if M5APPLE2_CARDPUTER_VARIANT_ADV
    default 2

config M5APPLE2_SD_PIN_MOSI
    int "SD MOSI pin"
    depends on M5APPLE2_SD_ENABLE
    default 14

config M5APPLE2_SD_PIN_MISO
    int "SD MISO pin"
    depends on M5APPLE2_SD_ENABLE
    default 39

config M5APPLE2_SD_PIN_CLK
    int "SD clock pin"
    depends on M5APPLE2_SD_ENABLE
    default 40

config M5APPLE2_SD_PIN_CS
    int "SD chip-select pin"
    depends on M5APPLE2_SD_ENABLE
    default 12

endmenu
```

## sdkconfig.defaults
```kconfig
CONFIG_IDF_TARGET="esp32s3"
CONFIG_PARTITION_TABLE_CUSTOM=y
CONFIG_PARTITION_TABLE_CUSTOM_FILENAME="partitions.csv"
CONFIG_ESPTOOLPY_FLASHSIZE_8MB=y
CONFIG_COMPILER_OPTIMIZATION_PERF=y
CONFIG_FREERTOS_HZ=1000
CONFIG_BT_ENABLED=n
CONFIG_ESP_WIFI_ENABLED=n
CONFIG_ESP_MAIN_TASK_STACK_SIZE=6144
```

## sdkconfig.defaults.adv
```kconfig
CONFIG_M5APPLE2_CARDPUTER_VARIANT_ADV=y
CONFIG_M5APPLE2_AUDIO_SAMPLE_RATE=48000
CONFIG_ESP_DEFAULT_CPU_FREQ_MHZ_240=y
CONFIG_ESP_DEFAULT_CPU_FREQ_MHZ=240
```
